## main/Kconfig.projbuild
```kconfig
menu "Motor controller"

config MOTORCTRL_WIFI_SSID
    string "WiFi SSID"
    default ""
    help
        WPA2-Personal SSID for the wireless control link. Leave empty
        to skip WiFi bring-up; the firmware continues to work over the
        existing USB-serial path.

config MOTORCTRL_WIFI_PASSWORD
    string "WiFi password"
    default ""
    help
        WPA2-Personal passphrase. Stored in the local sdkconfig only —
        do not commit a populated sdkconfig.

endmenu
```

## sdkconfig.defaults
```kconfig
# Flash (16 MB, QIO)
CONFIG_ESPTOOLPY_FLASHSIZE_16MB=y
CONFIG_ESPTOOLPY_FLASHMODE_QIO=y
CONFIG_ESPTOOLPY_FLASHFREQ_80M=y

# Octal PSRAM
CONFIG_SPIRAM=y
CONFIG_SPIRAM_MODE_OCT=y
CONFIG_SPIRAM_SPEED_80M=y
CONFIG_SPIRAM_FETCH_INSTRUCTIONS=y
CONFIG_SPIRAM_RODATA=y

# LVGL
CONFIG_LV_USE_FLOAT=y
CONFIG_LV_FONT_MONTSERRAT_14=y
CONFIG_LV_FONT_MONTSERRAT_18=y

# FreeRTOS tick rate
CONFIG_FREERTOS_HZ=1000

# TWAI in IRAM for lower latency
CONFIG_TWAI_ISR_IN_IRAM=y
```
